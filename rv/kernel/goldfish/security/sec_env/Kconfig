## rv/kernel/goldfish/security/sec_env/Kconfig
```kconfig
config SEC_ENV
	tristate "Android Security Envrionment Driver"
	default n
	help
	This is the secure environment driver for android.
```

## rv/kernel/samsung/2.6.35-tab/security/policy/Kconfig
```kconfig
config SEC_POLICY
	tristate "Android Security Policy"
	default n
	help
	This is the security policy driver for android.
```
